## config/west.yml
```yaml
manifest:
  remotes:
    - name: zmkfirmware
      url-base: https://github.com/zmkfirmware
    - name: caksoylar
      url-base: https://github.com/caksoylar
    - name: geeksville
      url-base: https://github.com/geeksville
    - name: beekeeb
      url-base: https://github.com/beekeeb
  projects:
    - name: zmk
      remote: zmkfirmware
      import: app/west.yml
      revision: edf5c0814fd3ea202e43aad2d68fd32e882a518c
    - name: zmk-rgbled-widget
      remote: caksoylar
      revision: v0.3
    - name: zmk_driver_azoteq
      remote: beekeeb
      revision: main
    - name: zmk-input-zoom
      remote: beekeeb
      revision: main
  self:
    path: config
```
